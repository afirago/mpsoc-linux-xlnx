## drivers/staging/mali/Kconfig
```kconfig
menuconfig ARM_MALI
	bool "ARM mali"
	help
	  Enable ARM Mali driver

if ARM_MALI
choice
	prompt "MALI Version"
	default ARM_MALI_R9P0_01REL0
	help
	  Select proper Mali version you want to use

config ARM_MALI_R9P0_01REL0
	bool "r9p0-01rel0"

endchoice

# Setup default options
config MALI400
	tristate
	default y

config MALI_DT
	def_bool y

# Source different driver versions
if ARM_MALI_R9P0_01REL0
source "drivers/staging/mali/DX910-SW-99002-r9p0-01rel0/driver/src/devicedrv/mali/Kconfig"
endif

endif
```
